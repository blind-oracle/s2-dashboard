## src/Kconfig.projbuild
```kconfig
menu "S2 Dashboard (LiveWire S2 CAN logger)"

    menu "CAN interface"

        config S2_CAN_TX_GPIO
            int "CAN TX GPIO (to transceiver TXD)"
            range 0 48
            default 4
            help
                ESP32-S3 GPIO driving the transceiver's TXD input. Any free GPIO works
                (routed through the GPIO matrix). GPIO4 is exposed on the ESP32-S3-Zero
                header and has no strapping or on-board function.
                Do NOT use: 0 (BOOT), 3/45/46 (strapping), 19/20 (USB), 21 (LED),
                26-37 (flash/PSRAM, not exposed), 43/44 (UART0), 22-25 (do not exist).

        config S2_CAN_RX_GPIO
            int "CAN RX GPIO (from transceiver RXD)"
            range 0 48
            default 5
            help
                ESP32-S3 GPIO reading the transceiver's RXD output. With an MCP2551
                (5 V part) this line MUST go through a resistor divider or level
                shifter: the ESP32-S3 is not 5 V tolerant. Same forbidden pins as TX.

        config S2_CAN_BITRATE
            int "Bus bitrate (bit/s)"
            range 10000 1000000
            default 500000
            help
                The LiveWire S2 secondary bus runs classical CAN at 500 kbit/s.

        config S2_CAN_LISTEN_ONLY
            bool "Listen-only mode (never transmit, never ACK)"
            default y
            help
                Passive tap: the controller does not acknowledge frames and never
                sends error frames, so a wiring or timing mistake cannot disturb
                the motorcycle's bus. Required off for UDS polling.

        config S2_CAN_RX_QUEUE_LEN
            int "RX frame queue depth"
            range 16 1024
            default 256

        config S2_CAN_TX_QUEUE_DEPTH
            int "Driver TX queue depth"
            range 1 32
            default 8

    endmenu

    menu "Serial logging"

        config S2_LOG_RAW_FRAMES
            bool "Log every received frame in candump-like format"
            default n
            help
                Prints "(t) can0 160#0003E80BB8000000" for each frame. Several
                hundred lines per second on a live bus; useful for captures.

        config S2_LOG_SIGNAL_CHANGES
            bool "Log decoded signals when their value changes"
            default y

        config S2_LOG_CHANGE_MIN_INTERVAL_MS
            int "Minimum interval between change logs of the same signal (ms)"
            range 0 60000
            default 250
            depends on S2_LOG_SIGNAL_CHANGES
            help
                Rate limit per signal so noisy channels (IMU, torque) do not flood
                the console. 0 logs every change.

        config S2_LOG_UNKNOWN_IDS
            bool "Log frames whose id is not in the database (first sight + changes)"
            default y

        config S2_SUMMARY_PERIOD_MS
            int "Period of the vehicle summary block (ms, 0 = off)"
            range 0 600000
            default 2000

        config S2_FRAME_TABLE_PERIOD_S
            int "Period of the per-id frame statistics table (s, 0 = off)"
            range 0 3600
            default 30

        config S2_E2E_SKIP_BAD_CRC
            bool "Do not decode E2E-protected frames that fail the CRC check"
            default y

        config S2_LOG_QUEUE_LEN
            int "Log line queue depth"
            range 8 512
            default 96
            help
                Log lines are produced by the decoder task and drained by a
                low-priority writer so a slow or absent USB host never stalls CAN
                reception. Lines are dropped (and counted) when the queue is full.

    endmenu

    menu "UDS diagnostics polling (transmits on the bus)"

        config S2_UDS_ENABLE
            bool "Poll diagnostic modules via UDS 0x22 ReadDataByIdentifier"
            default n
            depends on !S2_CAN_LISTEN_ONLY
            help
                Reads the DIDs of can-db/uds_catalog.json (per-cell voltages, pack
                current, motor RPM, wheel speeds, charger state, ...) through the
                BCM gateway. This TRANSMITS on the motorcycle's CAN bus. Only enable
                once the passive tap has been verified to decode broadcast frames
                cleanly (no CRC failures, stable frame rates).
                The requests use the same tester ids (0x7Ex/0x7Dx/0x7F0) as the
                instrument cluster's own diagnostics polling; the poller backs off
                for a few seconds whenever it sees another tester's request on the bus.

        config S2_UDS_REQUEST_TIMEOUT_MS
            int "Response timeout per request (ms)"
            range 50 5000
            default 500
            depends on S2_UDS_ENABLE

        config S2_UDS_INTER_REQUEST_GAP_MS
            int "Gap between consecutive requests (ms)"
            range 0 5000
            default 50
            depends on S2_UDS_ENABLE

        config S2_UDS_ROUND_PERIOD_MS
            int "Minimum period of one full pass over the catalog (ms)"
            range 100 600000
            default 5000
            depends on S2_UDS_ENABLE

        config S2_UDS_POLL_TCU
            bool "Include the telematics module (GPS position, cellular status)"
            default n
            depends on S2_UDS_ENABLE
            help
                The TCU exposes the live GPS position. Off by default because the
                data is privacy-sensitive when logs are shared.

        config S2_UDS_LOG_RAW
            bool "Hex-dump every UDS response"
            default y
            depends on S2_UDS_ENABLE

    endmenu

    menu "Display (ST7789 240x280 LCD)"

        config S2_DISPLAY_ENABLE
            bool "Drive an ST7789 240x280 IPS panel over SPI"
            default y
            help
                Renders the gathered CAN data on a 240x280 LCD (the common 1.69"
                ST7789V2 module). Driven through ESP-IDF's in-tree esp_lcd ST7789
                driver, with no Arduino / TFT_eSPI dependency.

        config S2_DISPLAY_SPI_HOST
            int "SPI host (2 = SPI2/FSPI, 3 = SPI3)"
            range 2 3
            default 2
            depends on S2_DISPLAY_ENABLE

        config S2_DISPLAY_SCLK_GPIO
            int "SCLK GPIO"
            range 0 48
            default 12
            depends on S2_DISPLAY_ENABLE
            help
                GPIO12 and GPIO11 are the SPI2 native pins on this chip, so they
                take the fast IO_MUX path.
                Do NOT use: 0 (BOOT), 3/45/46 (strapping), 19/20 (USB),
                21 (on-board LED), 26-37 (flash/PSRAM), 43/44 (UART0),
                22-25 (do not exist on the ESP32-S3), or the CAN pins.

        config S2_DISPLAY_MOSI_GPIO
            int "MOSI / DIN GPIO"
            range 0 48
            default 11
            depends on S2_DISPLAY_ENABLE
            help
                GPIO12 and GPIO11 are the SPI2 native pins on this chip, so they
                take the fast IO_MUX path.
                Do NOT use: 0 (BOOT), 3/45/46 (strapping), 19/20 (USB),
                21 (on-board LED), 26-37 (flash/PSRAM), 43/44 (UART0),
                22-25 (do not exist on the ESP32-S3), or the CAN pins.

        config S2_DISPLAY_CS_GPIO
            int "CS GPIO (-1 if the panel is the only device and CS is grounded)"
            range -1 48
            default 10
            depends on S2_DISPLAY_ENABLE

        config S2_DISPLAY_DC_GPIO
            int "DC / RS GPIO"
            range 0 48
            default 9
            depends on S2_DISPLAY_ENABLE
            help
                Data/command select.
                Do NOT use: 0 (BOOT), 3/45/46 (strapping), 19/20 (USB),
                21 (on-board LED), 26-37 (flash/PSRAM), 43/44 (UART0),
                22-25 (do not exist on the ESP32-S3), or the CAN pins.

        config S2_DISPLAY_RST_GPIO
            int "RST GPIO (-1 if tied to the board reset)"
            range -1 48
            default 8
            depends on S2_DISPLAY_ENABLE

        config S2_DISPLAY_BL_GPIO
            int "Backlight GPIO (-1 if hardwired on)"
            range -1 48
            default 7
            depends on S2_DISPLAY_ENABLE

        config S2_DISPLAY_BL_PWM
            bool "Dim the backlight with LEDC PWM"
            default y
            depends on S2_DISPLAY_ENABLE && S2_DISPLAY_BL_GPIO >= 0

        config S2_DISPLAY_BRIGHTNESS
            int "Backlight brightness (%)"
            range 1 100
            default 90
            depends on S2_DISPLAY_BL_PWM

        config S2_DISPLAY_SPI_HZ
            int "SPI clock (Hz)"
            range 1000000 62000000
            default 40000000
            depends on S2_DISPLAY_ENABLE
            help
                40 MHz is what the module vendor's own examples use and is reliable
                on short wiring. The ST7789V2 datasheet write cycle tops out at
                62.5 MHz. Lower it to 20 MHz if the image shows torn pixels.

        config S2_DISPLAY_ROTATE_180
            bool "Turn the image upside down"
            default n
            depends on S2_DISPLAY_ENABLE
            help
                For mounting the module the other way up. Only 0 and 180 degrees
                are offered: the framebuffer and the screen layout are 240 wide by
                280 tall, so a 90 degree turn would need both transposed.

        config S2_DISPLAY_X_GAP
            int "Column offset into the controller's frame memory"
            range 0 80
            default 0
            depends on S2_DISPLAY_ENABLE
            help
                The ST7789 has 240x320 of frame memory and a 240x280 panel shows
                rows 20..299 of it, so the defaults are 0 and 20. Change these only
                if your module shows the image shifted by a constant number of
                pixels, or wraps a band from the opposite edge.

        config S2_DISPLAY_Y_GAP
            int "Row offset into the controller's frame memory"
            range 0 80
            default 20
            depends on S2_DISPLAY_ENABLE

        config S2_DISPLAY_MIRROR_X
            bool "Mirror horizontally (on top of the rotation)"
            default n
            depends on S2_DISPLAY_ENABLE
            help
                Some modules ship mirrored relative to the usual orientation.
                Turn this on if the image is a left-right mirror of what it
                should be.

        config S2_DISPLAY_MIRROR_Y
            bool "Mirror vertically (on top of the rotation)"
            default n
            depends on S2_DISPLAY_ENABLE

        config S2_DISPLAY_INVERT_COLOR
            bool "Invert colours (needed by ST7789 IPS panels)"
            default y
            depends on S2_DISPLAY_ENABLE
            help
                These IPS panels ship needing display inversion on, and ESP-IDF's
                driver does not send it by itself. Turn this off only if the image
                looks like a photographic negative.

        config S2_DISPLAY_BGR
            bool "Panel expects BGR element order"
            default n
            depends on S2_DISPLAY_ENABLE
            help
                The 1.69" ST7789V2 modules are RGB, so this is off by default.
                Turn it on if red and blue are swapped.

        config S2_DISPLAY_REFRESH_HZ
            int "Screen refresh rate (Hz)"
            range 1 30
            default 10
            depends on S2_DISPLAY_ENABLE

        config S2_DISPLAY_BAND_ROWS
            int "Rows per SPI transfer when flushing the framebuffer"
            range 8 280
            default 40
            depends on S2_DISPLAY_ENABLE
            help
                The framebuffer is pushed in horizontal bands to bound the size of a
                single DMA transfer. 40 rows = 19200 bytes per transfer.

        config S2_DISPLAY_SCREENS
            int "Number of screens the button cycles through"
            range 1 8
            default 4
            depends on S2_DISPLAY_ENABLE
            help
                Screen 1 shows the ride data; the rest are placeholders for now.

        choice
            prompt "What cycles the screens"
            default S2_DISPLAY_BUTTON_VEHICLE
            depends on S2_DISPLAY_ENABLE

            config S2_DISPLAY_BUTTON_VEHICLE
                bool "A button on the motorcycle's own handlebar (over CAN)"
                help
                    The secondary bus broadcasts several momentary controls, so no
                    extra switch has to be wired. Choose which one below.

            config S2_DISPLAY_BUTTON_PIN
                bool "A switch wired to a GPIO pin"
                help
                    Useful on the bench, where there is no bus to listen to.

            config S2_DISPLAY_BUTTON_OFF
                bool "Nothing (screen 1 only)"

        endchoice

        choice
            prompt "Which handlebar button"
            default S2_VEHICLE_BUTTON_INFO
            depends on S2_DISPLAY_BUTTON_VEHICLE
            help
                Every option is a control the database documents as a two-state
                byte on the broadcast bus. The screens advance on each press, so
                prefer a button that does nothing else while riding.

            config S2_VEHICLE_BUTTON_INFO
                bool "Dash info / scroll button (0x354 D1)"
                help
                    The button the rider already uses to page through the
                    instrument cluster, and it has no other effect. Database
                    confidence is STRONG.

            config S2_VEHICLE_BUTTON_HORN
                bool "Horn (0x354 D2)"
                help
                    CONFIRMED, but it sounds the horn every time.

            config S2_VEHICLE_BUTTON_HIGHBEAM
                bool "High beam (0x152 D3)"
                help
                    STRONG. A flash-to-pass tap cycles the screen too.

            config S2_VEHICLE_BUTTON_FRONT_BRAKE
                bool "Front brake lever (0x15A D6)"
                help
                    CONFIRMED, but it fires on every brake application.

            config S2_VEHICLE_BUTTON_REAR_BRAKE
                bool "Rear brake lever (0x133 D4)"
                help
                    CONFIRMED, but it fires on every brake application.

            config S2_VEHICLE_BUTTON_HAZARDS
                bool "Hazard switch (0x15A D2)"
                help
                    CONFIRMED as a byte, but whether it follows the switch or the
                    blink is not pinned down. If it blinks, the screens will
                    advance repeatedly while the hazards are on.

            config S2_VEHICLE_BUTTON_CRUISE
                bool "Cruise control arm switch (0x160 D6 bit 7)"
                help
                    CONFIRMED. Latching, so one press per arm and one per disarm.

        endchoice

        config S2_DISPLAY_BUTTON_GPIO
            int "Screen button GPIO (-1 to disable)"
            range -1 48
            default 6
            depends on S2_DISPLAY_BUTTON_PIN
            help
                Wire a momentary switch between this pin and GND; the internal
                pull-up is enabled. A press cycles to the next screen.

        config S2_DISPLAY_BUTTON_ACTIVE_LOW
            bool "Button pulls the pin low when pressed"
            default y
            depends on S2_DISPLAY_BUTTON_PIN && S2_DISPLAY_BUTTON_GPIO >= 0

        config S2_DISPLAY_POWER_FULL_SCALE_KW
            int "Power gauge full scale (kW)"
            range 5 200
            default 70
            depends on S2_DISPLAY_ENABLE
            help
                The S2 peaks near 69 kW on discharge.

        config S2_DISPLAY_REGEN_FULL_SCALE_KW
            int "Regen gauge full scale (kW)"
            range 1 100
            default 20
            depends on S2_DISPLAY_ENABLE

    endmenu

    menu "Status LED"

        config S2_STATUS_LED_ENABLE
            bool "Drive the on-board WS2812 RGB LED as a bus status indicator"
            default y

        config S2_STATUS_LED_GPIO
            int "WS2812 data GPIO"
            range 0 48
            default 21
            depends on S2_STATUS_LED_ENABLE
            help
                GPIO21 on the Waveshare ESP32-S3-Zero.

    endmenu

    menu "Vehicle constants"

        config S2_TORQUE_COUNTS_PER_NM_X100
            int "Torque scale: counts per Nm, x100"
            range 50 2000
            default 335
            help
                0x161 carries torque in counts; the database's Nm estimate is
                3.0-3.7 counts/Nm and is explicitly TENTATIVE, so any reported Nm
                value is an estimate. 335 = 3.35 counts/Nm.

                Used by both the display and the BLE dashboard frame, so it is
                not conditional on either.

    endmenu

    menu "Firmware updates over Wi-Fi (OTA)"

        config S2_OTA_ENABLE
            bool "Allow the firmware to update itself over the air"
            default y
            help
                Holding the screen button puts the dashboard into update mode: it
                reboots, brings up its own Wi-Fi access point and serves an upload
                page. Connect a phone, open the page in any browser and pick a
                .bin file. No app and no stored credentials.

                Requires a partition table with two app slots. That is set by
                board_build.partitions in platformio.ini, NOT by the Kconfig
                partition option, because the PlatformIO ESP-IDF builder reads the
                former and ignores the latter. Changing to a two-slot table needs
                one wired flash; after that, updates are wireless.

                Also requires the display. Update mode is entered by holding the
                screen button and the access point passphrase is generated fresh
                each time and shown on the screen, so with the display disabled
                there is neither a way in nor a way to learn the password.

        config S2_OTA_AP_SSID
            string "Access point name"
            default "S2-DASH-OTA"
            depends on S2_OTA_ENABLE
            help
                Shown in the phone's Wi-Fi list while update mode is active.

        config S2_OTA_LONG_PRESS_MS
            int "Hold time to enter update mode (ms)"
            range 500 10000
            default 2000
            depends on S2_OTA_ENABLE
            help
                How long the screen button must be held. A hold of this length
                does not also cycle the screen.

                Note the default button is the bike's own dash info/scroll
                button, which the instrument cluster uses for trip resets. If a
                long hold turns out to do something on the cluster, raise this or
                pick a different button under Display.

        config S2_OTA_IDLE_TIMEOUT_S
            int "Leave update mode after this long with no upload (s)"
            range 30 3600
            default 300
            depends on S2_OTA_ENABLE
            help
                Update mode reboots back to normal operation when nothing has
                been uploaded for this long, so the access point is never left up
                by accident. The timer stops while an upload is in progress.

        config S2_OTA_SELF_TEST_S
            int "Confirm a new image after this long (s)"
            range 5 300
            default 30
            depends on S2_OTA_ENABLE
            help
                A freshly flashed image runs on probation. If it stays up this
                long with every subsystem started, it is marked valid. If it
                panics or trips the watchdog first, the bootloader reverts to the
                previous slot on the next boot.

    endmenu

    menu "BLE telemetry"

        config S2_BLE_ENABLE
            bool "Publish the decoded data over Bluetooth LE"
            default y
            help
                Advertises as a BLE peripheral carrying two services: the Nordic
                UART Service, which published Android terminal apps read with no
                development, and a custom telemetry service for a purpose-built
                app. See the GATT contract section of README.md.

                The ESP32-S3 has no Bluetooth Classic radio, so there is no SPP
                option: BLE is the only choice on this chip.

        config S2_BLE_DEVICE_NAME
            string "Advertised device name"
            default "S2-DASH"
            depends on S2_BLE_ENABLE
            help
                Shown in the phone's scan list. Keep it short: the name shares a
                31-byte advertising packet with the flags.

        config S2_BLE_NUS_ENABLE
            bool "Expose the Nordic UART Service (plain text)"
            default y
            depends on S2_BLE_ENABLE
            help
                Streams "name=value" lines that nRF Toolbox's UART module, nRF
                Connect and Serial Bluetooth Terminal can display as they are.
                Turn this off to save a little RAM when only a custom app will
                ever connect; the custom service stays available either way.

        config S2_BLE_DASH_HZ
            int "Dashboard notify rate (Hz)"
            range 1 20
            default 5
            depends on S2_BLE_ENABLE
            help
                How often the fixed 24-byte ride frame is notified while a client
                is subscribed. This is the live-gauge path, so it runs faster than
                the full snapshot.

        config S2_BLE_SNAPSHOT_MS
            int "Full snapshot period (ms)"
            range 200 10000
            default 1000
            depends on S2_BLE_ENABLE
            help
                How often every database signal is notified as binary records.
                A snapshot is about 900 bytes, so this is several notifications.

        config S2_BLE_TEXT_PERIOD_MS
            int "Text line period (ms)"
            range 200 10000
            default 1000
            depends on S2_BLE_ENABLE && S2_BLE_NUS_ENABLE
            help
                How often the ride values are sent as text on the UART service.
                A full "all" dump is sent on request rather than on this timer,
                because 113 lines would swamp a terminal app.

    endmenu

endmenu
```
